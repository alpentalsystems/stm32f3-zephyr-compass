## CMakeLists.txt
```
cmake_minimum_required(VERSION 3.20.0)

# Flash with OpenOCD; the board default is STM32CubeProgrammer.
set(BOARD_FLASH_RUNNER openocd)

find_package(Zephyr REQUIRED HINTS $ENV{ZEPHYR_BASE})
project(stm32f3_compass)

target_include_directories(app PRIVATE ../lib/compass/include)
target_sources(app PRIVATE
  src/main.c
  src/leds.c
  src/sensors.c
  src/cal_store.c
  ../lib/compass/compass.c
)
```

## Kconfig
```
config APP_RAW_STREAM
	bool "Print raw sensor data as CSV"
	help
	  Print RAW,ax,ay,az,mx,my,mz lines at the sample rate, in board
	  axes and before calibration: accel in m/s^2, magn in gauss.

source "Kconfig.zephyr"
```

## prj.conf
```kconfig
CONFIG_GPIO=y
CONFIG_LOG=y
CONFIG_SENSOR=y
CONFIG_FPU=y
CONFIG_CBPRINTF_FP_SUPPORT=y
CONFIG_MAIN_STACK_SIZE=2048

CONFIG_FLASH=y
CONFIG_FLASH_MAP=y
CONFIG_NVS=y
CONFIG_SETTINGS=y
CONFIG_SETTINGS_NVS=y
# storage_partition is 6 KB: three 2 KB flash pages.
CONFIG_SETTINGS_NVS_SECTOR_COUNT=3
```

## src/main.c
```c
#include <errno.h>
#include <zephyr/drivers/gpio.h>
#include <zephyr/kernel.h>
#include <zephyr/logging/log.h>
#include <zephyr/sys/atomic.h>
#include <zephyr/sys/printk.h>

#include "cal_store.h"
#include "compass.h"
#include "leds.h"
#include "sensors.h"

LOG_MODULE_REGISTER(app, LOG_LEVEL_INF);

#define TICK_MS 50
#define TICKS_PER_SECOND (1000 / TICK_MS)
#define EMA_ALPHA 0.2f
#define HYSTERESIS_DEG 5.0f
#define MAX_READ_ERRORS 20
#define CAL_DURATION_MS 15000
#define SPIN_TICKS_PER_STEP 2
#define DEBOUNCE_MS 200

#define FLASHES_UNCALIBRATED 2
#define FLASHES_CAL_SAVED 1
#define FLASHES_CAL_REJECTED 3
#define FLASHES_SAVE_FAILED 5

enum mode {
	MODE_RUN,
	MODE_CALIBRATE,
};

static const struct gpio_dt_spec button = GPIO_DT_SPEC_GET(DT_ALIAS(sw0), gpios);
static struct gpio_callback button_cb;
static atomic_t button_pressed;
static int64_t last_press_ms;

static void on_button(const struct device *port, struct gpio_callback *cb, uint32_t pins)
{
	int64_t now = k_uptime_get();

	ARG_UNUSED(port);
	ARG_UNUSED(cb);
	ARG_UNUSED(pins);

	if ((now - last_press_ms) < DEBOUNCE_MS) {
		return;
	}
	last_press_ms = now;
	atomic_set(&button_pressed, 1);
}

static int button_init(void)
{
	int err;

	if (!gpio_is_ready_dt(&button)) {
		return -ENODEV;
	}
	err = gpio_pin_configure_dt(&button, GPIO_INPUT);
	if (err != 0) {
		return err;
	}
	err = gpio_pin_interrupt_configure_dt(&button, GPIO_INT_EDGE_TO_ACTIVE);
	if (err != 0) {
		return err;
	}
	gpio_init_callback(&button_cb, on_button, BIT(button.pin));
	return gpio_add_callback(button.port, &button_cb);
}

static bool take_button_press(void)
{
	return atomic_cas(&button_pressed, 1, 0);
}

static void fatal_blink(void)
{
	for (;;) {
		/* Nothing left to report an LED error to. */
		(void)leds_flash_all(1);
	}
}

static void flash_all(int times)
{
	int err = leds_flash_all(times);

	if (err != 0) {
		LOG_ERR("LED flash failed: %d", err);
	}
}

static void print_raw(const struct vec3 *a, const struct vec3 *m)
{
	printk("RAW,%.3f,%.3f,%.3f,%.4f,%.4f,%.4f\n", (double)a->x, (double)a->y,
	       (double)a->z, (double)m->x, (double)m->y, (double)m->z);
}

static void load_offset(struct vec3 *offset)
{
	int err = cal_store_load(offset);

	if (err == 0) {
		LOG_INF("calibration loaded: %.3f %.3f %.3f", (double)offset->x,
			(double)offset->y, (double)offset->z);
		return;
	}
	if (err == -ENOENT) {
		LOG_WRN("no saved calibration; press USER to calibrate");
	} else {
		LOG_ERR("loading calibration failed: %d", err);
	}
	offset->x = 0.0f;
	offset->y = 0.0f;
	offset->z = 0.0f;
	flash_all(FLASHES_UNCALIBRATED);
}

static void finish_calibration(const struct compass_cal *cal, struct vec3 *offset)
{
	struct vec3 new_offset;
	int err = cal_offsets(cal, &new_offset);

	if (err != COMPASS_OK) {
		LOG_WRN("calibration rejected (%d): turn flat in a full circle, then flip and tilt",
			err);
		flash_all(FLASHES_CAL_REJECTED);
		return;
	}
	*offset = new_offset;
	LOG_INF("calibration: %.3f %.3f %.3f", (double)offset->x, (double)offset->y,
		(double)offset->z);

	err = cal_store_save(offset);
	if (err != 0) {
		LOG_ERR("saving calibration failed: %d", err);
		flash_all(FLASHES_SAVE_FAILED);
		return;
	}
	flash_all(FLASHES_CAL_SAVED);
}

int main(void)
{
	struct vec3 offset;
	struct compass_cal cal;
	struct compass_ema accel_f = {0};
	struct compass_ema magn_f = {0};
	enum mode mode = MODE_RUN;
	int64_t cal_end_ms = 0;
	int led = COMPASS_LED_NONE;
	int read_errors = 0;
	uint32_t tick = 0U;
	int err;

	err = leds_init();
	if (err != 0) {
		LOG_ERR("LEDs not ready: %d", err);
		return 0;
	}
	err = sensors_init();
	if (err != 0) {
		LOG_ERR("sensors not ready: %d", err);
		fatal_blink();
	}
	err = button_init();
	if (err != 0) {
		LOG_ERR("button not ready: %d", err);
		fatal_blink();
	}
	load_offset(&offset);

	for (;;) {
		struct vec3 a;
		struct vec3 m;
		float heading;

		k_msleep(TICK_MS);
		tick++;

		if (take_button_press()) {
			if (mode == MODE_RUN) {
				cal_reset(&cal);
				cal_end_ms = k_uptime_get() + CAL_DURATION_MS;
				mode = MODE_CALIBRATE;
				LOG_INF("calibration started: turn flat in a full circle, "
					"then flip and tilt");
			} else {
				mode = MODE_RUN;
				LOG_INF("calibration canceled");
			}
			led = COMPASS_LED_NONE;
		}

		err = sensors_read(&a, &m);
		if (err != 0) {
			if (read_errors == 0) {
				LOG_ERR("sensor read failed: %d", err);
			}
			read_errors++;
			if (read_errors >= MAX_READ_ERRORS) {
				LOG_ERR("%d sensor reads failed in a row", read_errors);
				fatal_blink();
			}
			continue;
		}
		read_errors = 0;
		if (IS_ENABLED(CONFIG_APP_RAW_STREAM)) {
			print_raw(&a, &m);
		}

		if (mode == MODE_CALIBRATE) {
			cal_update(&cal, &m);
			err = leds_show((int)((tick / SPIN_TICKS_PER_STEP) % COMPASS_LED_COUNT));
			if (err != 0) {
				LOG_ERR("LED update failed: %d", err);
			}
			if (k_uptime_get() >= cal_end_ms) {
				finish_calibration(&cal, &offset);
				magn_f.initialized = false;
				mode = MODE_RUN;
			}
			continue;
		}

		m.x -= offset.x;
		m.y -= offset.y;
		m.z -= offset.z;
		ema_update(&accel_f, &a, EMA_ALPHA);
		ema_update(&magn_f, &m, EMA_ALPHA);
		if (tilt_compensated_heading(&accel_f.value, &magn_f.value, &heading) !=
		    COMPASS_OK) {
			continue;
		}
		led = north_led_index(heading, led, HYSTERESIS_DEG);
		err = leds_show(led);
		if (err != 0) {
			LOG_ERR("LED update failed: %d", err);
		}
		if ((tick % TICKS_PER_SECOND) == 0U) {
			LOG_INF("heading %.1f deg, north LED %d", (double)heading, led);
		}
	}
	return 0;
}
```

## src/cal_store.c
```c
#include <errno.h>
#include <stdbool.h>
#include <string.h>
#include <zephyr/settings/settings.h>

#include "cal_store.h"

#define KEY_LEAF "mag_offset"

static struct vec3 loaded_offset;
static bool found;

static int compass_settings_set(const char *key, size_t len, settings_read_cb read_cb,
				void *cb_arg)
{
	ssize_t n;

	if (strcmp(key, KEY_LEAF) != 0) {
		return -ENOENT;
	}
	if (len != sizeof(loaded_offset)) {
		return -EINVAL;
	}
	n = read_cb(cb_arg, &loaded_offset, sizeof(loaded_offset));
	if (n < 0) {
		return (int)n;
	}
	if (n != (ssize_t)sizeof(loaded_offset)) {
		return -EIO;
	}
	found = true;
	return 0;
}

SETTINGS_STATIC_HANDLER_DEFINE(compass, "compass", NULL, compass_settings_set, NULL, NULL);

int cal_store_load(struct vec3 *offset)
{
	int err = settings_subsys_init();

	if (err != 0) {
		return err;
	}
	found = false;
	err = settings_load_subtree("compass");
	if (err != 0) {
		return err;
	}
	if (!found) {
		return -ENOENT;
	}
	*offset = loaded_offset;
	return 0;
}

int cal_store_save(const struct vec3 *offset)
{
	return settings_save_one("compass/" KEY_LEAF, offset, sizeof(*offset));
}
```

## src/cal_store.h
```c
#ifndef CAL_STORE_H_
#define CAL_STORE_H_

#include "compass.h"

/* Returns 0, -ENOENT when no calibration is saved, or a negative errno. */
int cal_store_load(struct vec3 *offset);

int cal_store_save(const struct vec3 *offset);

#endif /* CAL_STORE_H_ */
```

## src/leds.c
```c
#include <errno.h>
#include <zephyr/drivers/gpio.h>
#include <zephyr/kernel.h>

#include "compass.h"
#include "leds.h"

#define FLASH_MS 200

/* Ring positions in compass order, starting at the N edge. */
static const struct gpio_dt_spec ring[COMPASS_LED_COUNT] = {
	GPIO_DT_SPEC_GET(DT_NODELABEL(red_led_3), gpios),    /* N  LD3  */
	GPIO_DT_SPEC_GET(DT_NODELABEL(orange_led_5), gpios), /* NE LD5  */
	GPIO_DT_SPEC_GET(DT_NODELABEL(green_led_7), gpios),  /* E  LD7  */
	GPIO_DT_SPEC_GET(DT_NODELABEL(blue_led_9), gpios),   /* SE LD9  */
	GPIO_DT_SPEC_GET(DT_NODELABEL(red_led_10), gpios),   /* S  LD10 */
	GPIO_DT_SPEC_GET(DT_NODELABEL(orange_led_8), gpios), /* SW LD8  */
	GPIO_DT_SPEC_GET(DT_NODELABEL(green_led_6), gpios),  /* W  LD6  */
	GPIO_DT_SPEC_GET(DT_NODELABEL(blue_led_4), gpios),   /* NW LD4  */
};

int leds_init(void)
{
	for (int i = 0; i < COMPASS_LED_COUNT; i++) {
		int err;

		if (!gpio_is_ready_dt(&ring[i])) {
			return -ENODEV;
		}
		err = gpio_pin_configure_dt(&ring[i], GPIO_OUTPUT_INACTIVE);
		if (err != 0) {
			return err;
		}
	}
	return 0;
}

int leds_show(int index)
{
	for (int i = 0; i < COMPASS_LED_COUNT; i++) {
		int err = gpio_pin_set_dt(&ring[i], (i == index) ? 1 : 0);

		if (err != 0) {
			return err;
		}
	}
	return 0;
}

int leds_set_all(bool on)
{
	for (int i = 0; i < COMPASS_LED_COUNT; i++) {
		int err = gpio_pin_set_dt(&ring[i], on ? 1 : 0);

		if (err != 0) {
			return err;
		}
	}
	return 0;
}

int leds_flash_all(int times)
{
	for (int i = 0; i < times; i++) {
		int err = leds_set_all(true);

		if (err != 0) {
			return err;
		}
		k_msleep(FLASH_MS);
		err = leds_set_all(false);
		if (err != 0) {
			return err;
		}
		k_msleep(FLASH_MS);
	}
	return 0;
}
```

## src/leds.h
```c
#ifndef LEDS_H_
#define LEDS_H_

#include <stdbool.h>

int leds_init(void);

/* Light one ring position (0 = N, clockwise); COMPASS_LED_NONE turns all off. */
int leds_show(int index);

int leds_set_all(bool on);

/* Blocking: all LEDs on and off, 200 ms each, the given number of times. */
int leds_flash_all(int times);

#endif /* LEDS_H_ */
```

## src/sensors.c
```c
#include <errno.h>
#include <stdint.h>
#include <zephyr/device.h>
#include <zephyr/drivers/sensor.h>

#include "sensors.h"

static const struct device *const accel_dev = DEVICE_DT_GET(DT_ALIAS(accel0));
static const struct device *const magn_dev = DEVICE_DT_GET(DT_ALIAS(magn0));

/* Board axis n = sign * chip axis src. */
struct axis_map {
	uint8_t src;
	int8_t sign;
};

/* Measured: flat gives chip z +1 g, N edge up raises chip y, E edge up lowers chip x. */
static const struct axis_map accel_map[3] = {{1, 1}, {0, -1}, {2, -1}};
/* Measured: facing N vs S changes chip y, W vs E changes chip x; z sign keeps the dip constant. */
static const struct axis_map magn_map[3] = {{1, 1}, {0, -1}, {2, -1}};

static struct vec3 to_board(const struct sensor_value raw[3], const struct axis_map map[3])
{
	float chip[3] = {
		sensor_value_to_float(&raw[0]),
		sensor_value_to_float(&raw[1]),
		sensor_value_to_float(&raw[2]),
	};
	struct vec3 out = {
		(float)map[0].sign * chip[map[0].src],
		(float)map[1].sign * chip[map[1].src],
		(float)map[2].sign * chip[map[2].src],
	};

	return out;
}

int sensors_init(void)
{
	if (!device_is_ready(accel_dev) || !device_is_ready(magn_dev)) {
		return -ENODEV;
	}
	return 0;
}

int sensors_read(struct vec3 *accel, struct vec3 *magn)
{
	struct sensor_value raw[3];
	int err;

	err = sensor_sample_fetch(accel_dev);
	if (err != 0) {
		return err;
	}
	err = sensor_channel_get(accel_dev, SENSOR_CHAN_ACCEL_XYZ, raw);
	if (err != 0) {
		return err;
	}
	*accel = to_board(raw, accel_map);

	err = sensor_sample_fetch(magn_dev);
	if (err != 0) {
		return err;
	}
	err = sensor_channel_get(magn_dev, SENSOR_CHAN_MAGN_XYZ, raw);
	if (err != 0) {
		return err;
	}
	*magn = to_board(raw, magn_map);
	return 0;
}
```

## src/sensors.h
```c
#ifndef SENSORS_H_
#define SENSORS_H_

#include "compass.h"

int sensors_init(void);

/* Accel in m/s^2 and magn in gauss, in board axes (x N edge, y E edge, z down). */
int sensors_read(struct vec3 *accel, struct vec3 *magn);

#endif /* SENSORS_H_ */
```
